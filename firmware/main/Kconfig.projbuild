## firmware/main/Kconfig.projbuild
```kconfig
menu "Bullerby Chat"

    config BULLERBY_DEFAULT_FAMILY_ID
        int "Default family id (first boot only, before NVS has a value)"
        range 1 255
        default 8
        help
            Written to NVS on first boot if no family_id is stored yet. Per-device
            assignment uses model_set_my_family_id() or a future provisioning flow;
            OTA updates keep the value in the nvs partition.

    config BULLERBY_ENABLE_NET
        bool "Enable networking (WiFi + server HTTP/WS)"
        default n
        help
            When enabled, the device initialises WiFi, connects to the Bullerby
            Worker, fetches config, opens a WebSocket for inbound messages, and
            uploads recordings. Disable for pure offline UI/audio development.

            Requires CONFIG_BULLERBY_WIFI_SSID / PASS / SERVER_URL /
            DEVICE_ID below to be filled in — prefer a local
            (gitignored) sdkconfig for real credentials.

    config BULLERBY_WIFI_SSID
        string "WiFi SSID"
        depends on BULLERBY_ENABLE_NET
        default ""
        help
            NVS bullerby/wifi_ssid (and wifi_pass) is tried first. If NVS has no
            SSID, this Kconfig value is used when non-empty. If there are still no
            credentials, or STA cannot get an IP in 45 s, the device opens an open
            SoftAP (name Bullerby-XXXX) with a captive portal to store credentials
            in NVS, then reboots.

    config BULLERBY_WIFI_PASS
        string "WiFi password"
        depends on BULLERBY_ENABLE_NET
        default ""

    config BULLERBY_SERVER_URL
        string "Server base URL (e.g. https://bullerby.example.workers.dev)"
        depends on BULLERBY_ENABLE_NET
        default "https://bullerby-chat.example.workers.dev"
        help
            No trailing slash. WebSocket scheme is derived by swapping
            https:// → wss:// and http:// → ws://.

    config BULLERBY_DEVICE_ID
        string "Device id when not using MAC (matches bullerby.json devices[].id)"
        depends on BULLERBY_ENABLE_NET
        default "device-uuid-001"
        help
            Used only when **Derive device id from chip WiFi MAC** is disabled. When MAC
            derivation is enabled, this string is ignored at runtime — each chip sends
            esp-<12 hex> from the factory WiFi MAC so normal idf.py flash never collides
            across boards. Add that exact esp-… string to server config, or turn MAC
            derivation off and rely on this value (same image on every board then shares
            one id — only for lab use).

    config BULLERBY_DEVICE_ID_FROM_MAC
        bool "Derive device id from chip WiFi MAC (esp-<12 hex>)"
        depends on BULLERBY_ENABLE_NET
        default y
        help
            **Recommended for real hardware:** replaces the device id string with
            esp- plus the six factory WiFi STA MAC bytes in hex. The value is stable
            across idf.py flash (flash does not change efuse MAC). List each board’s
            esp-… id under devices[].id in server/config/bullerby.json (same firmware
            binary can go to every unit). NVS device_id, if present, is still overwritten
            when this is on — turn it off only if you intentionally use a fixed string.

endmenu
```

## firmware/sdkconfig.defaults
```kconfig
# Bullerby Chat — ESP32-S3 sdkconfig defaults

# Target
CONFIG_IDF_TARGET="esp32s3"

# Flash — 16MB QIO
CONFIG_ESPTOOLPY_FLASHMODE_QIO=y
CONFIG_ESPTOOLPY_FLASHSIZE_16MB=y
CONFIG_ESPTOOLPY_FLASHFREQ_80M=y

# PSRAM — Octal 80MHz
CONFIG_SPIRAM=y
CONFIG_SPIRAM_MODE_OCT=y
CONFIG_SPIRAM_SPEED_80M=y
CONFIG_SPIRAM_USE_MALLOC=y
CONFIG_SPIRAM_MALLOC_ALWAYSINTERNAL=2048
CONFIG_SPIRAM_MALLOC_RESERVE_INTERNAL=98304
CONFIG_SPIRAM_MEMTEST=n

# CPU — 240MHz
CONFIG_ESP_DEFAULT_CPU_FREQ_MHZ_240=y

# Partition table — custom
CONFIG_PARTITION_TABLE_CUSTOM=y
CONFIG_PARTITION_TABLE_CUSTOM_FILENAME="partitions.csv"
CONFIG_PARTITION_TABLE_OFFSET=0x8000

# Compiler
CONFIG_COMPILER_OPTIMIZATION_SIZE=y

# Bullerby (see main/Kconfig.projbuild)
CONFIG_BULLERBY_ENABLE_NET=n
CONFIG_BULLERBY_DEFAULT_FAMILY_ID=8

# TLS: embed Mozilla CA bundle so esp-tls / esp_http_client / esp_websocket_client
# can verify Cloudflare Workers certs without pinning a single CA.
CONFIG_MBEDTLS_CERTIFICATE_BUNDLE=y
CONFIG_MBEDTLS_CERTIFICATE_BUNDLE_DEFAULT_FULL=y
CONFIG_ESP_TLS_USING_MBEDTLS=y

# LVGL: light theme paints lv_obj cards white — unreadable on round LCD
CONFIG_LV_THEME_DEFAULT_DARK=y

# WiFi
CONFIG_ESP_WIFI_SOFTAP_SUPPORT=y
CONFIG_ESP_WIFI_STATIC_RX_BUFFER_NUM=4
CONFIG_ESP_WIFI_DYNAMIC_RX_BUFFER_NUM=16
CONFIG_ESP_WIFI_DYNAMIC_TX_BUFFER_NUM=16
CONFIG_ESP_WIFI_RX_BA_WIN=3

# LWIP
CONFIG_LWIP_MAX_SOCKETS=16
CONFIG_LWIP_TCPIP_RECVMBOX_SIZE=16

# Log level — Info for dev
CONFIG_LOG_DEFAULT_LEVEL_INFO=y
CONFIG_LOG_MAXIMUM_LEVEL_DEBUG=y

# Stack sizes
CONFIG_ESP_MAIN_TASK_STACK_SIZE=8192
CONFIG_ESP_SYSTEM_EVENT_TASK_STACK_SIZE=4096

# Watchdog — generous for dev
CONFIG_ESP_TASK_WDT_TIMEOUT_S=10

# Instruction / data cache
CONFIG_ESP32S3_INSTRUCTION_CACHE_32KB=y
CONFIG_ESP32S3_DATA_CACHE_LINE_64B=y

# LVGL
CONFIG_LV_OS_NONE=y
CONFIG_LV_USE_CLIB_MALLOC=y
CONFIG_LV_USE_CLIB_STRING=y
CONFIG_LV_USE_CLIB_SPRINTF=y
CONFIG_LV_FONT_MONTSERRAT_12=y
CONFIG_LV_FONT_MONTSERRAT_14=y
CONFIG_LV_FONT_MONTSERRAT_20=y
CONFIG_LV_FONT_MONTSERRAT_28=y

# Disable unused LVGL widgets to save flash
CONFIG_LV_USE_ANIMIMG=n
CONFIG_LV_USE_CALENDAR=n
CONFIG_LV_USE_CHART=n
CONFIG_LV_USE_KEYBOARD=n
CONFIG_LV_USE_LED=n
CONFIG_LV_USE_LIST=n
CONFIG_LV_USE_MENU=n
CONFIG_LV_USE_MSGBOX=n
CONFIG_LV_USE_SPAN=n
CONFIG_LV_USE_SPINBOX=n
CONFIG_LV_USE_SPINNER=n
CONFIG_LV_USE_TABVIEW=n
CONFIG_LV_USE_TILEVIEW=n
CONFIG_LV_USE_WIN=n
CONFIG_LV_BUILD_EXAMPLES=n
CONFIG_LV_BUILD_DEMOS=n

# FreeRTOS
CONFIG_FREERTOS_HZ=1000

# ES8311 uses legacy I2C; esp_driver_i2c is still linked elsewhere — allow coexistence
CONFIG_I2C_SKIP_LEGACY_CONFLICT_CHECK=y
```
